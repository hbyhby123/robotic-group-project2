/*
====================================================
三路红外循迹小车（PID高速灵敏版）
B000 ~ B111 状态机 + PID

优化内容：
1. 直线稳定
2. 转弯更灵敏
3. 大弯不冲线
4. 支持急弯/U弯
5. 保留状态机风格
6. 使用大范围 error
====================================================
*/

/*
====================================================
电机PWM引脚
====================================================
*/

int enablePin1 = 10;   // 右电机PWM
int enablePin2 = 9;    // 左电机PWM

/*
====================================================
电机方向引脚
====================================================
*/

int in1Pin = 4;   // 右电机方向1
int in2Pin = 5;   // 右电机方向2

int in3Pin = 2;   // 左电机方向1
int in4Pin = 3;   // 左电机方向2

/*
====================================================
红外引脚
左 中 右
====================================================
*/

const int irPins[3] = {A5, A4, A3};

/*
====================================================
threshold
根据你的实际传感器调节
====================================================
*/

int thresholds[3] =
{
    640,
    460,
    570
};

/*
====================================================
传感器状态
====================================================
*/

int irSensorDigital[3];
int irSensors = B000;

/*
====================================================
基础速度
====================================================
*/

int baseSpeed = 90;

/*
====================================================
PID参数
====================================================
*/

float Kp = 0.45;
float Ki = 0.00;
float Kd = 2.0;

/*
====================================================
PID变量
====================================================
*/

float error = 0;
float lastError = 0;

float integral = 0;
float derivative = 0;

float pid = 0;

/*
====================================================
电机速度
====================================================
*/

int leftMotorSpeed = 0;
int rightMotorSpeed = 0;

/*
====================================================
初始化
====================================================
*/

void setup()
{
    Serial.begin(9600);

    pinMode(enablePin1, OUTPUT);
    pinMode(enablePin2, OUTPUT);

    pinMode(in1Pin, OUTPUT);
    pinMode(in2Pin, OUTPUT);

    pinMode(in3Pin, OUTPUT);
    pinMode(in4Pin, OUTPUT);
}

/*
====================================================
主循环
====================================================
*/

void loop()
{
    Scan();

    CalculateError();

    PID_Control();

    Drive(leftMotorSpeed, rightMotorSpeed);

    delay(2);
}

/*
====================================================
扫描红外
====================================================
*/

void Scan()
{
    irSensors = B000;

    for (int i = 0; i < 3; i++)
    {
        int sensorValue =
            analogRead(irPins[i]);

        /*
        ====================================================
        黑线 = 1
        ====================================================
        */

        if (sensorValue >= thresholds[i])
        {
            irSensorDigital[i] = 1;
        }
        else
        {
            irSensorDigital[i] = 0;
        }

        /*
        ====================================================
        左中右
        ====================================================
        */

        int b = 2 - i;

        irSensors =
            irSensors +
            (irSensorDigital[i] << b);
    }

    /*
    ====================================================
    串口输出
    ====================================================
    */

    Serial.print("STATE: B");
    Serial.print(irSensors, BIN);

    Serial.print("  ERROR: ");
    Serial.print(error);

    Serial.print("  PID: ");
    Serial.print(pid);

    Serial.print("  LEFT: ");
    Serial.print(leftMotorSpeed);

    Serial.print("  RIGHT: ");
    Serial.println(rightMotorSpeed);
}

/*
====================================================
根据状态生成误差
====================================================
*/

void CalculateError()
{
    switch(irSensors)
    {

        /*
        ====================================================
        正中间
        ====================================================
        */

        case B010:

            error = 0;
            break;

        /*
        ====================================================
        微左
        ====================================================
        */

        case B110:

            error = -40;
            break;

        /*
        ====================================================
        大左
        ====================================================
        */

        case B100:

            error = -80;
            break;

        /*
        ====================================================
        微右
        ====================================================
        */

        case B011:

            error = 40;
            break;

        /*
        ====================================================
        大右
        ====================================================
        */

        case B001:

            error = 80;
            break;

        /*
        ====================================================
        丢线
        ====================================================
        */

        case B000:

            if (lastError < 0)
            {
                error = -130;
            }
            else
            {
                error = 130;
            }

            break;

        /*
        ====================================================
        十字路口
        ====================================================
        */

        case B111:

            error = 0;
            break;

        /*
        ====================================================
        默认
        ====================================================
        */

        default:

            error = lastError;
    }
}

/*
====================================================
PID控制
====================================================
*/

void PID_Control()
{
    /*
    ====================================================
    PID计算
    ====================================================
    */

    integral =
        integral + error;

    /*
    ====================================================
    防积分爆炸
    ====================================================
    */

    integral =
        constrain(integral, -300, 300);

    derivative =
        error - lastError;

    pid =
        (Kp * error) +
        (Ki * integral) +
        (Kd * derivative);

    lastError = error;

    /*
    ====================================================
    动态速度
    大弯自动减速
    ====================================================
    */

    int currentBaseSpeed;

    if (abs(error) >= 80)
    {
        currentBaseSpeed = 75;
    }
    else
    {
        currentBaseSpeed = baseSpeed;
    }

    /*
    ====================================================
    计算左右轮速度
    ====================================================
    */

    leftMotorSpeed =
        currentBaseSpeed + pid;

    rightMotorSpeed =
        currentBaseSpeed - pid;

    /*
    ====================================================
    限幅
    ====================================================
    */

    leftMotorSpeed =
        constrain(leftMotorSpeed, 0, 255);

    rightMotorSpeed =
        constrain(rightMotorSpeed, 0, 255);
}

/*
====================================================
驱动电机
====================================================
*/

void Drive(int leftSpeed, int rightSpeed)
{
    /*
    ====================================================
    右电机
    ====================================================
    */

    analogWrite(enablePin1, rightSpeed);

    digitalWrite(in1Pin, HIGH);
    digitalWrite(in2Pin, LOW);

    /*
    ====================================================
    左电机
    ====================================================
    */

    analogWrite(enablePin2, leftSpeed);

    digitalWrite(in3Pin, LOW);
    digitalWrite(in4Pin, HIGH);
}